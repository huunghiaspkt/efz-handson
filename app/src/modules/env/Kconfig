## app/src/modules/env/Kconfig
```kconfig
# SPDX-License-Identifier: Apache-2.0

config APP_MODULE_ENV
	bool "SHT30 temperature and humidity"
	default y
	depends on $(dt_nodelabel_enabled,sht30)
	select SENSOR
```

## app/src/modules/io/Kconfig
```kconfig
# SPDX-License-Identifier: Apache-2.0

config APP_MODULE_IO
	bool "Buttons and LEDs"
	default y
	select GPIO
	select INPUT
```

## drivers/sensor/sht30/Kconfig
```kconfig
# SPDX-License-Identifier: Apache-2.0

config EFZ_SHT30
	bool "SHT30 driver (efz-handson)"
	default y
	depends on DT_HAS_EMBEDDEDFUN_SHT30_ENABLED
	select I2C
	select CRC
```

## dts/bindings/sensor/embeddedfun,sht30.yaml
```yaml
# SPDX-License-Identifier: Apache-2.0

description: Sensirion SHT30 temperature and humidity sensor (efz-handson driver)

compatible: "embeddedfun,sht30"

include: [sensor-device.yaml, i2c-device.yaml]
```

## west.yml
```yaml
# SPDX-License-Identifier: Apache-2.0

manifest:
  remotes:
    - name: zephyrproject-rtos
      url-base: https://github.com/zephyrproject-rtos

  projects:
    - name: zephyr
      remote: zephyrproject-rtos
      revision: main
      clone-depth: 1
      import:
        # By using name-allowlist we can clone only the modules that are
        # strictly needed by the application.
        name-allowlist:
          - hal_espressif         # the ESP32-S3 on the EFZ board
          - lvgl                  # the TFT display UI
          - fatfs                 # the microSD card
          - mbedtls               # Wi-Fi security
          - tf-psa-crypto         # Wi-Fi security (used by mbedtls)
          - tf-psa-crypto-drivers # Wi-Fi security (used by mbedtls)
```
